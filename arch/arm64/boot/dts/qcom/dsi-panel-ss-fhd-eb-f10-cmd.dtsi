/* Copyright (c) 2019, The Linux Foundation. All rights reserved.
 *
 * This program is free software; you can redistribute it and/or modify
 * it under the terms of the GNU General Public License version 2 and
 * only version 2 as published by the Free Software Foundation.
 *
 * This program is distributed in the hope that it will be useful,
 * but WITHOUT ANY WARRANTY; without even the implied warranty of
 * MERCHANTABILITY or FITNESS FOR A PARTICULAR PURPOSE.  See the
 * GNU General Public License for more details.
 */

/*---------------------------------------------------------------------------
 * This file is autogenerated file using gcdb parser. Please do not edit it.
 * Update input XML file to add a new entry or update variable in this file
 * VERSION = "1.0"
 *---------------------------------------------------------------------------*/
&soc {
	dsi_ss_fhd_eb_f10_cmd: qcom,mdss_dsi_ss_fhd_eb_f10_cmd {
		qcom,mdss-dsi-panel-name = "ss eb fhd cmd dsi panel";
		qcom,mdss-dsi-panel-id = <0>;
		qcom,mdss-dsi-panel-model = "SS FHD EB CMD PANEL";
		qcom,mdss-dsi-panel-sleepwrmod = <0>;
		qcom,mdss-dsi-panel-type = "dsi_cmd_mode";
		qcom,mdss-dsi-virtual-channel-id = <0>;
		qcom,mdss-dsi-stream = <0>;
		qcom,mdss-dsi-bpp = <24>;
		qcom,mdss-dsi-underflow-color = <0xff>;
		qcom,mdss-dsi-border-color = <0>;
		qcom,mdss-dsi-traffic-mode = "burst_mode";
		qcom,mdss-dsi-bllp-eof-power-mode;
		qcom,mdss-dsi-bllp-power-mode;
		qcom,ulps-enabled;
		qcom,mdss-dsi-lp11-init;
		qcom,mdss-dsi-lane-0-state;
		qcom,mdss-dsi-lane-1-state;
		qcom,mdss-dsi-lane-2-state;
		qcom,mdss-dsi-lane-3-state;
		qcom,mdss-brightness-remap;
		qcom,mdss-brightness-max-level = <2047>;
		qcom,bl-update-flag = "delay_until_first_frame";
		qcom,mdss-dsi-dma-trigger = "trigger_sw";
		qcom,mdss-dsi-mdp-trigger = "none";
		qcom,mdss-dsi-bl-dcs-type-ss-eb;
		qcom,mdss-dsi-reset-sequence = <0 1>, <1 10>;
		qcom,mdss-pan-physical-width-dimension = <68>;
		qcom,mdss-pan-physical-height-dimension = <147>;
		qcom,mdss-dsi-te-pin-select = <1>;
		qcom,mdss-dsi-wr-mem-start = <0x2c>;
		qcom,mdss-dsi-wr-mem-continue = <0x3c>;
		qcom,mdss-dsi-te-dcs-command = <1>;
		qcom,mdss-dsi-te-check-enable;
		qcom,mdss-dsi-te-using-te-pin;
		qcom,mdss-dsi-tx-eot-append;
		qcom,mdss-dsi-panel-hdr-enabled;
		qcom,mdss-dsi-panel-hdr-color-primaries = <14500 15500 32000
			17000 15500 30000 8000 3000>;
		qcom,mdss-dsi-panel-peak-brightness = <4300000>;
		qcom,mdss-dsi-panel-blackness-level = <3230>;

		qcom,dispparam-enabled;
		/* IRQF_ONESHOT | IRQF_TRIGGER_FALLING */
		qcom,esd-err-irq-gpio = <&tlmm 32 0x2002>;

		qcom,disp-doze-backlight-threshold = <8>;
		qcom,disp-fod-off-dimming-delay = <85>;

		qcom,mdss-dsi-display-timings {
			timing@0{
				qcom,mdss-dsi-panel-width = <1080>;
				qcom,mdss-dsi-panel-height = <2340>;
				qcom,mdss-dsi-h-front-porch = <64>;
				qcom,mdss-dsi-h-back-porch = <64>;
				qcom,mdss-dsi-h-pulse-width = <20>;
				qcom,mdss-dsi-h-sync-skew = <0>;
				qcom,mdss-dsi-v-back-porch = <64>;
				qcom,mdss-dsi-v-front-porch = <64>;
				qcom,mdss-dsi-v-pulse-width = <20>;
				qcom,mdss-dsi-h-left-border = <0>;
				qcom,mdss-dsi-h-right-border = <0>;
				qcom,mdss-dsi-v-top-border = <0>;
				qcom,mdss-dsi-v-bottom-border = <0>;
				qcom,mdss-dsi-panel-framerate = <66>;
				qcom,mdss-dsi-panel-clockrate = <1210000000>;
				qcom,mdss-dsi-panel-jitter = <0x5 0x1>;
				qcom,mdss-dsi-on-command = [39 01 00 00 00 00 02 b0 00 39 00 00 00 00 00 2c bb 59 ff ff ff ef cf ab 87 63 3f 4a 48 46 44 42 40 3e 3c 3a 64 00 ff ff ff ff ff ff ff ff ff 00 00 00 00 00 00 00 00 00 02 02 42 00 39 00 00 00 00 00 03 d4 00 8d 39 00 00 00 00 00 02 fa 0f 39 01 00 00 00 00 02 b0 80 39 00 00 00 00 00 02 e6 00 39 00 00 00 00 00 02 35 00 39 00 00 00 00 00 05 2a 00 00 04 37 39 00 00 00 00 00 05 2b 00 00 09 23 39 00 00 00 00 00 03 51 01 00 05 01 00 00 6e 00 02 11 00 05 01 00 00 10 00 02 29 00 39 01 00 00 00 00 02 b0 00 39 01 00 00 00 00 04 f0 cf c3 00 39 01 00 00 00 00 04 f0 cf c4 00];
				qcom,mdss-dsi-off-command = [05 01 00 00 00 00 02 28 00 05 01 00 00 78 00 02 10 00];
				qcom,mdss-dsi-on-command-state = "dsi_lp_mode";
				qcom,mdss-dsi-off-command-state = "dsi_lp_mode";
				qcom,mdss-dsi-dispparam-hbm-fod-off-command = [39 01 00 00 00 00 02 53 20];
				qcom,mdss-dsi-dispparam-hbm-fod-off-command-state = "dsi_hs_mode";
				qcom,mdss-dsi-dispparam-hbm-fod-on-command = [39 00 00 00 00 00 02 88 00 39 01 00 00 00 00 02 53 e0];
				qcom,mdss-dsi-dispparam-hbm-fod-on-command-state = "dsi_hs_mode";
				qcom,mdss-dsi-doze-hbm-command = [39 01 00 00 00 00 03 51 00 ff 39 01 00 00 00 00 02 b0 00 39 01 00 00 00 00 04 f0 bb 2a 40 39 01 00 00 00 00 02 53 20];
				qcom,mdss-dsi-doze-lbm-command = [39 01 00 00 00 00 03 51 00 40 39 01 00 00 00 00 02 b0 00 39 01 00 00 00 00 04 f0 bb 2a 40 39 01 00 00 00 00 02 53 20];
				qcom,mdss-dsi-nolp-command = <0x39010000 0x351 0x1003901 0x00 0x2b00039 0x1000000 0x4f0bb 0x2a403901 0x100 0x2532039 0x1000000 0x28800>;
				qcom,mdss-dsi-doze-hbm-command-state = "dsi_lp_mode";
				qcom,mdss-dsi-doze-lbm-command-state = "dsi_lp_mode";
				qcom,mdss-dsi-nolp-command-state = "dsi_lp_mode";
				qcom,mdss-dsi-lp1-command = [39 01 00 00 00 00 03 51 00 00 39 01 00 00 00 00 02 88 01];
				qcom,mdss-dsi-lp1-command-state = "dsi_lp_mode";
				qcom,mdss-dsi-dispparam-acl-off-command = [39 01 00 00 00 00 02 55 00];
				qcom,mdss-dsi-dispparam-acl-off-command-state = "dsi_lp_mode";
				qcom,mdss-dsi-dispparam-acl-l1-command = [39 01 00 00 00 00 02 55 01];
				qcom,mdss-dsi-dispparam-acl-l1-command-state = "dsi_lp_mode";
				qcom,mdss-dsi-dispparam-acl-l2-command = [39 01 00 00 00 00 02 55 02];
				qcom,mdss-dsi-dispparam-acl-l2-command-state = "dsi_lp_mode";
				qcom,mdss-dsi-dispparam-acl-l3-command = [39 01 00 00 00 00 02 55 03];
				qcom,mdss-dsi-dispparam-acl-l3-command-state = "dsi_lp_mode";
				qcom,mdss-dsi-dispparam-hbm-off-command = [39 01 00 00 ff 00 02 53 28 39 01 00 00 00 00 02 53 20];
				qcom,mdss-dsi-dispparam-hbm-off-command-state = "dsi_lp_mode";
				qcom,mdss-dsi-dispparam-hbm-on-command = [39 01 00 00 00 00 02 53 e8];
				qcom,mdss-dsi-dispparam-hbm-on-command-state = "dsi_lp_mode";

				/*
				qcom,mdss-dsi-dispparam-dimmingon-command = [39 01 00 00 01 00 02 53 28];
				qcom,mdss-dsi-dispparam-dimmingon-command-state = "dsi_lp_mode";
				qcom,mdss-dsi-dispparam-dimmingoff-command = [39 01 00 00 01 00 02 53 20];
				qcom,mdss-dsi-dispparam-dimmingoff-command-state = "dsi_lp_mode";
				*/
				/*
				qcom,mdss-dsi-dispparam-crc-srgb-on-command = [
					];
				qcom,mdss-dsi-dispparam-crc-srgb-on-command-state = "dsi_lp_mode";
				qcom,mdss-dsi-dispparam-crc-dcip3-on-command = [
					];
				qcom,mdss-dsi-dispparam-crc-dcip3-on-command-state = "dsi_lp_mode";
				qcom,mdss-dsi-dispparam-crc-off-command = [
					];
				qcom,mdss-dsi-dispparam-crc-off-command-state = "dsi_lp_mode";
				*/
				qcom,mdss-dsi-h-sync-pulse = <0>;
			};
		};
	};
};
